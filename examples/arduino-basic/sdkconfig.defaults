## examples/arduino-basic/sdkconfig.defaults
```kconfig
CONFIG_AUTOSTART_ARDUINO=y
CONFIG_FREERTOS_HZ=1000
CONFIG_ESPTOOLPY_FLASHSIZE_8MB=y
CONFIG_COMPILER_OPTIMIZATION_SIZE=y
CONFIG_ESP_MAIN_TASK_STACK_SIZE=8192
CONFIG_LWIP_IPV4=y
CONFIG_LWIP_IPV6=y
CONFIG_LWIP_IP4_FRAG=y
CONFIG_LWIP_IP4_REASSEMBLY=y
CONFIG_LWIP_MAX_SOCKETS=24
CONFIG_MBEDTLS_CERTIFICATE_BUNDLE=y
CONFIG_MBEDTLS_CERTIFICATE_BUNDLE_DEFAULT_FULL=y
CONFIG_MBEDTLS_CHACHAPOLY_C=y
CONFIG_MBEDTLS_CHACHA20_C=y
CONFIG_MBEDTLS_POLY1305_C=y
CONFIG_MBEDTLS_HKDF_C=y
CONFIG_ML_ENABLE_CONFIG_HTTPD=n
CONFIG_ML_MAX_PEERS=4
CONFIG_ML_H2_BUFFER_SIZE_KB=128
CONFIG_ML_JSON_BUFFER_SIZE_KB=128
CONFIG_SPIRAM=y
CONFIG_SPIRAM_TYPE_AUTO=y
CONFIG_SPIRAM_MODE_OCT=y
CONFIG_SPIRAM_SPEED_80M=y
CONFIG_SPIRAM_USE_MALLOC=y
CONFIG_SPIRAM_MALLOC_ALWAYSINTERNAL=4096
CONFIG_SPIRAM_MALLOC_RESERVE_INTERNAL=32768
```

## examples/idf-basic/main/Kconfig.projbuild
```kconfig
menu "ESP32 Tailnet example"
    config EXAMPLE_WIFI_SSID
        string "Wi-Fi SSID"
        default ""

    config EXAMPLE_WIFI_PASSWORD
        string "Wi-Fi password"
        default ""

    config EXAMPLE_TAILNET_AUTH_KEY
        string "Tailnet enrollment auth key"
        default ""

    config EXAMPLE_TAILNET_HOSTNAME
        string "Tailnet hostname"
        default "esp32-tailnet"
endmenu
```
